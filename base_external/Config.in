## base_external/Config.in
```kconfig
#source "$BR2_EXTERNAL_project_base_PATH/package/aesd-assignments/Config.in"
source "$BR2_EXTERNAL_project_base_PATH/package/gpio_package/Config.in"
#source "$BR2_EXTERNAL_project_base_PATH/package/bttest/Config.in"
```

## base_external/package/gpio_package/Config.in
```kconfig
config BR2_PACKAGE_GPIO_PACKAGE
	bool "gpio-package"
	help
	  Simple code for GPIO pins on Raspberry Pi 3.
```
